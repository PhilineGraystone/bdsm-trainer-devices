#include <ESP8266WiFi.h>
#include <WiFiClient.h>
#include <Adafruit_GFX.h>
#include <Adafruit_SSD1306.h>
#include <PubSubClient.h>
#include <Wire.h>
#include <Ticker.h>

#define RelaisPin D5

const char* SSID        = "<SSID>";
const char* PASSWORD    = "<PASSWORD>";
const char* MQTT_BROKER = "<MQTT BROKER HOST>";
const char* MQTT_USER   = "punisher";
const char* MQTT_PASS   = "punisher";
const char* MQTT_CLIENT = "torturedevice01";

Adafruit_SSD1306 display(128, 64, &Wire, -1);
Ticker timer;
WiFiClient espClient;
PubSubClient client(espClient);

long lastMsg = 0;
char msg[50];
char serialmsg[50];
String para;
String para2;
int value = 0;
unsigned long timercount = 0;
volatile int interrupts;
volatile int seconds;
volatile int counter;
const int led = 13;
const int relay = 14;
const int tickinsec = 32;

static const uint8_t bondage[1024] = {
  0x00, 0x00, 0x00, 0x00, 0x00, 0x00, 0x00, 0x00, 0x00, 0x00, 0x00, 0x00, 0x00, 0x00, 0x00, 0x00,
  0x00, 0x00, 0x00, 0x00, 0x00, 0x00, 0x00, 0x07, 0xe0, 0x00, 0x00, 0x00, 0x00, 0x00, 0x00, 0x00,
  0x00, 0x00, 0x00, 0x00, 0x00, 0x00, 0x01, 0xff, 0xff, 0x80, 0x00, 0x00, 0x00, 0x00, 0x00, 0x00,
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  0x00, 0x00, 0x00, 0x00, 0x00, 0x00, 0x00, 0x00, 0x00, 0x00, 0x00, 0x00, 0x00, 0x00, 0x00, 0x00
};

static const uint8_t shock[528] = {
  0x00, 0x00, 0x00, 0x00, 0x30, 0x00, 0x00, 0x00, 0x00, 0x00, 0x00, 0x00, 0x70, 0x00, 0x00, 0x00,
  0x00, 0x00, 0x00, 0x00, 0x70, 0x00, 0x00, 0x00, 0x00, 0x00, 0x00, 0x00, 0xf0, 0x00, 0x00, 0x00,
  0x00, 0x00, 0x00, 0x70, 0xf0, 0x00, 0x00, 0x00, 0x00, 0x00, 0x03, 0xe1, 0xf0, 0xc0, 0x00, 0x00,
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  0x00, 0x00, 0x00, 0x1e, 0x00, 0x00, 0x00, 0x00, 0x00, 0x00, 0x00, 0x0c, 0x00, 0x00, 0x00, 0x00
};

void ICACHE_RAM_ATTR onTimerISR() {
  if ( interrupts >= (seconds * tickinsec) )  {
    digitalWrite(RelaisPin, !(digitalRead(RelaisPin))); //Toggle LED Pin
    snprintf (msg, 50, "SHOCKED: DONE -  %ld", millis());
    client.publish("punisher/devices/torturedevice01/response", msg);

    showLogo();
    interrupts = 0;
    timer1_disable();
  } else  {
    interrupts++;
    timer1_write(2500000);
  }
}

String getValue(String data, char separator, int index) {
  int found = 0;
  int strIndex[] = { 0, -1 };
  int maxIndex = data.length() - 1;

  for (int i = 0; i <= maxIndex && found <= index; i++) {
    if (data.charAt(i) == separator || i == maxIndex) {
      found++;
      strIndex[0] = strIndex[1] + 1;
      strIndex[1] = (i == maxIndex) ? i + 1 : i;
    }
  }
  return found > index ? data.substring(strIndex[0], strIndex[1]) : "";
}

void setup(void) {
  pinMode(led, OUTPUT);
  digitalWrite(led, 0);

  pinMode(RelaisPin, OUTPUT);
  digitalWrite(RelaisPin, 0);

  Serial.begin(115200);
  Serial.println("");

  setup_wifi();

  if (!display.begin(SSD1306_SWITCHCAPVCC, 0x3C)) {
    Serial.println(F("SSD1306 allocation failed"));
    for (;;); // Don't proceed, loop forever
  }
  timer1_attachInterrupt(onTimerISR);
  client.setServer(MQTT_BROKER, 1883);
  client.setCallback(callback);

  showLogo();
}

void setup_wifi() {
  delay(10);
  Serial.println();
  Serial.print("Connecting to ");
  Serial.println(SSID);

  WiFi.mode(WIFI_STA);
  WiFi.begin(SSID, PASSWORD);

  while (WiFi.status() != WL_CONNECTED) {
    delay(500);
    Serial.print(".");
  }

  Serial.println("");
  Serial.println("WiFi connected");
  Serial.println("IP address: ");
  Serial.println(WiFi.localIP());
}

void callback(char* topic, byte* payload, unsigned int length) {
  Serial.print("Received message [");
  Serial.print(topic);
  Serial.print("] ");
  char msg[length + 1];
  for (int i = 0; i < length; i++) {
    Serial.print((char)payload[i]);
    msg[i] = (char)payload[i];
  }
  msg[length] = '\0';
  Serial.println();

  para   = String(msg);
  para.trim();
  para2 = getValue(para, ',', 0);
  para  = getValue(para, ',', 1);

  seconds = para.toInt();
  counter = para2.toInt();
  snprintf(serialmsg, 50, "Shock for %u seconds with Counter = %u", seconds, counter);
  Serial.println(serialmsg);
  if ( counter != 0 ) {
   for (int i = 0; i <= counter; i++) {
      value = counter - i;
      Serial.print( i );
      Serial.println();
      display.clearDisplay();
      display.setTextColor(WHITE);
      display.setTextSize(5);

      if ( value > 9 ) {
        display.setCursor(30, 10);
      } else if ( value < 10 )  {
        display.setCursor(45, 10);
      }
      
      display.println( value );
      display.display();
      delay(1000);
    }

  }

  digitalWrite(RelaisPin, 1);
  snprintf (msg, 50, "SHOCKED! -  %ld", millis());
  client.publish("punisher/devices/torturedevice01/response", msg);
  display.clearDisplay();
  display.drawBitmap(32, 0, shock, 64, 64, 1);
  display.display();

  timer1_enable(TIM_DIV1, TIM_EDGE, TIM_SINGLE);
  timer1_write(120000); //120000 us
}

void reconnect() {
  while (!client.connected()) {
    Serial.println("Reconnecting MQTT...");
    if (!client.connect(MQTT_CLIENT, MQTT_USER, MQTT_PASS)) {
      Serial.print("failed, rc=");
      Serial.print(client.state());
      Serial.println(" retrying in 5 seconds");
      delay(5000);
    }
  }
  client.subscribe("punisher/functions/shock");
  client.subscribe("punisher/devices/torturedevice01/shock");
  Serial.println("MQTT Connected...");
}

void loop(void) {
  if (!client.connected()) {
    reconnect();
  }
  if (timercount == 0)  {
    snprintf (msg, 50, "availabe -  %ld", millis());
    client.publish("punisher/devices/torturedevice01/available", msg);
    timercount = 100000;
    display.display();
  }
  timercount--;
  client.loop();
}

void showLogo() {
  display.clearDisplay();
  display.drawBitmap(0, 0, bondage, 128, 64, 1);
}
